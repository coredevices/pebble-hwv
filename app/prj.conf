## CMakeLists.txt
```
cmake_minimum_required(VERSION 3.13.1)
find_package(Zephyr REQUIRED HINTS $ENV{ZEPHYR_BASE})

project(app LANGUAGES C)

target_sources(
  app
  PRIVATE
    src/audio_data.c
    src/main.c
    src/ble.c
    src/buttons.c
    src/charger.c
    src/display.c
    src/flash.c
    src/haptic.c
    src/imu.c
    src/light.c
    src/mag.c
    src/mic.c
    src/press.c
    src/speaker.c
)

if (CONFIG_BOARD_ASTERIX)
  target_sources(
    app
    PRIVATE
      src/lfxo.c
  )
endif()
```

## sample.yaml
```
sample:
  description: Pebble HWV
  name: pebble-hwv
common:
  build_only: true
  integration_platforms:
    - asterix
tests:
  app.default: {}
```

## prj.conf
```kconfig
CONFIG_BT=y
CONFIG_BT_PERIPHERAL=y
CONFIG_BT_DEVICE_NAME="Pebble HWV"
CONFIG_BT_CTLR_TX_PWR_PLUS_4=y
CONFIG_BT_SHELL=y
CONFIG_BT_OBSERVER=y

CONFIG_CBPRINTF_FP_SUPPORT=y

CONFIG_INPUT=y
CONFIG_DISPLAY=y
CONFIG_SERIAL=y
CONFIG_HAPTIC=y
CONFIG_SENSOR=y
CONFIG_REGULATOR=y
CONFIG_FLASH=y
CONFIG_FLASH_JESD216_API=y
#CONFIG_I2S=y
CONFIG_AUDIO=y
CONFIG_AUDIO_DMIC=y

CONFIG_SHELL=y
CONFIG_PM_DEVICE=y
CONFIG_PM_DEVICE_RUNTIME=y
CONFIG_HEAP_MEM_POOL_SIZE=2048

CONFIG_REGULATOR_SHELL=y

CONFIG_CONSOLE=y
CONFIG_UART_CONSOLE=y

CONFIG_NORDIC_QSPI_NOR_INIT_PRIORITY=90


CONFIG_ASSERT=y
CONFIG_NRFX_I2S0=y
```

## boards/asterix.overlay
```dts
&timer2 {
	status = "okay";
};
```

## src/main.c
```c
#include "speaker.h"
#include "buttons.h"
#include "charger.h"
#include "display.h"
#include "flash.h"
#include "haptic.h"
#include "light.h"
#include "imu.h"
#include "mag.h"
#include "mic.h"
#include "press.h"

#ifdef CONFIG_BOARD_ASTERIX
#include "lfxo.h"
#endif

#include <stdio.h>

#include <zephyr/shell/shell.h>
#include <zephyr/sys/util.h>

#include <app_version.h>

SHELL_SUBCMD_SET_CREATE(hwv_cmds, (hwv));
SHELL_CMD_REGISTER(hwv, &hwv_cmds, "HWV commands", NULL);

int main(void)
{
	int ret;

	printf("HWV v%s-%s\n", APP_VERSION_STRING, STRINGIFY(APP_BUILD_VERSION));

	ret = buttons_init();
	if (ret < 0) {
		printf("Failed to initialize buttons module (%d)\n", ret);
	}

	ret = charger_init();
	if (ret < 0) {
		printf("Failed to initialize charger module (%d)\n", ret);
	}

	ret = display_init();
	if (ret < 0) {
		printf("Failed to initialize display module (%d)\n", ret);
	}

	ret = flash_init();
	if (ret < 0) {
		printf("Failed to initialize flash module (%d)\n", ret);
	}

	ret = haptic_init();
	if (ret < 0) {
		printf("Failed to initialize haptic module (%d)\n", ret);
	}

	ret = light_init();
	if (ret < 0) {
		printf("Failed to initialize light sensor module (%d)\n", ret);
	}

	ret = imu_init();
	if (ret < 0) {
		printf("Failed to initialize IMU module (%d)\n", ret);
	}

	ret = mag_init();
	if (ret < 0) {
		printf("Failed to initialize magnetometer module (%d)\n", ret);
	}

	ret = mic_init();
	if (ret < 0) {
		printf("Failed to initialize microphone module (%d)\n", ret);
	}

	ret = press_init();
	if (ret < 0) {
		printf("Failed to initialize pressure sensor module (%d)\n", ret);
	}

	ret = speaker_init();
	if (ret < 0) {
		printf("Failed to initialize speaker module (%d)\n", ret);
	}

#ifdef CONFIG_BOARD_ASTERIX
	ret = lfxo_init();
	if (ret < 0) {
		printf("Failed to initialize LFXO module (%d)\n", ret);
	}
#endif

	return 0;
}
```

## src/flash.c
```c
#include <stdlib.h>

#include <zephyr/drivers/flash.h>
#include <zephyr/drivers/regulator.h>
#include <zephyr/kernel.h>
#include <zephyr/pm/device.h>
#include <zephyr/random/random.h>
#include <zephyr/shell/shell.h>

#include <nrfx_qspi.h>

#define FLASH_STRESS_TEST_SIZE 1024

static const struct device *const flash = DEVICE_DT_GET(DT_ALIAS(flash0));
static bool initialized;

static uint32_t xorshift32(uint32_t seed)
{
	seed ^= seed << 13;
	seed ^= seed >> 17;
	seed ^= seed < 5;
	return seed;
}

static int cmd_flash_id(const struct shell *sh, size_t argc, char **argv)
{
	int ret;
	uint8_t id[3];

	ARG_UNUSED(argc);
	ARG_UNUSED(argv);

	if (!initialized) {
		shell_error(sh, "Flash module not initialized");
		return -EPERM;
	}

	ret = pm_device_action_run(flash, PM_DEVICE_ACTION_RESUME);
	if (ret < 0) {
		shell_error(sh, "Failed to resume flash (%d)", ret);
		return ret;
	}

	ret = flash_read_jedec_id(flash, id);
	if (ret < 0) {
		shell_error(sh, "Failed to read flash ID (%d)", ret);
		goto end;
	}

	shell_print(sh, "Flash ID: %02x %02x %02x", id[0], id[1], id[2]);

end:
	(void)pm_device_action_run(flash, PM_DEVICE_ACTION_SUSPEND);

	return ret;
}

static int cmd_flash_erase(const struct shell *sh, size_t argc, char **argv)
{
	int ret;
	uint32_t addr;
	struct flash_pages_info info;

	if (!initialized) {
		shell_error(sh, "Flash module not initialized");
		return -EPERM;
	}

	if (argc < 2) {
		shell_error(sh, "Missing address or size");
		return -EINVAL;
	}

	addr = strtoul(argv[1], NULL, 0);

	ret = pm_device_action_run(flash, PM_DEVICE_ACTION_RESUME);
	if (ret < 0) {
		shell_error(sh, "Failed to resume flash (%d)", ret);
		return ret;
	}

	ret = flash_get_page_info_by_offs(flash, addr, &info);
	if (ret < 0) {
		shell_error(sh, "Could not determine page size (%d)", ret);
		goto end;
	}

	ret = flash_erase(flash, addr, info.size);
	if (ret < 0) {
		shell_error(sh, "Failed to erase flash (%d)", ret);
		goto end;
	}

	shell_print(sh, "Erased %d bytes at 0x%08x", info.size, addr);

end:
	(void)pm_device_action_run(flash, PM_DEVICE_ACTION_SUSPEND);

	return ret;
}

static int cmd_flash_read(const struct shell *sh, size_t argc, char **argv)
{
	int ret;
	uint32_t addr;
	uint8_t buf[SHELL_HEXDUMP_BYTES_IN_LINE];
	size_t len;

	if (!initialized) {
		shell_error(sh, "Flash module not initialized");
		return -EPERM;
	}

	if (argc < 3) {
		shell_error(sh, "Missing address or length");
		return -EINVAL;
	}

	addr = strtoul(argv[1], NULL, 0);
	len = strtoul(argv[2], NULL, 0);

	ret = pm_device_action_run(flash, PM_DEVICE_ACTION_RESUME);
	if (ret < 0) {
		shell_error(sh, "Failed to resume flash (%d)", ret);
		return ret;
	}

	while (len > 0U) {
		size_t rd = MIN(len, sizeof(buf));

		ret = flash_read(flash, addr, buf, rd);
		if (ret < 0) {
			shell_error(sh, "Failed to read from flash (%d)", ret);
			goto end;
		}

		shell_hexdump_line(sh, addr, buf, rd);

		addr += rd;
		len -= rd;
	}

end:
	(void)pm_device_action_run(flash, PM_DEVICE_ACTION_SUSPEND);

	return ret;
}

static int cmd_flash_write(const struct shell *sh, size_t argc, char **argv)
{
	int ret;
	uint32_t addr;
	uint8_t *buf;
	size_t data_len;

	if (!initialized) {
		shell_error(sh, "Flash module not initialized");
		return -EPERM;
	}

	if (argc < 3) {
		shell_error(sh, "Missing address or data");
		return -EINVAL;
	}

	addr = strtoul(argv[1], NULL, 0);
	data_len = strlen(argv[2]) / 2U;

	buf = k_malloc(data_len);
	if (buf == NULL) {
		shell_error(sh, "Failed to allocate buffer");
		return -ENOMEM;
	}

	for (size_t i = 0U; i < data_len; i++) {
		buf[i] = strtoul(&argv[2][i * 2], NULL, 16);
	}

	ret = pm_device_action_run(flash, PM_DEVICE_ACTION_RESUME);
	if (ret < 0) {
		shell_error(sh, "Failed to resume flash (%d)", ret);
		k_free(buf);
		return ret;
	}

	ret = flash_write(flash, addr, buf, data_len);
	if (ret < 0) {
		shell_error(sh, "Failed to write to flash (%d)", ret);
	} else {
		shell_print(sh, "Wrote %d bytes to 0x%08x", data_len, addr);
	}

	k_free(buf);

	(void)pm_device_action_run(flash, PM_DEVICE_ACTION_SUSPEND);

	return ret;
}

static int cmd_flash_stress(const struct shell *sh, size_t argc, char **argv)
{
	int ret;
	unsigned int iters;
	struct flash_pages_info info;
	uint8_t *buf;
	uint64_t flash_size;

	if (!initialized) {
		shell_error(sh, "Flash module not initialized");
		return -EPERM;
	}

	if (argc < 2) {
		iters = 1;
	} else {
		iters = (unsigned int)strtoul(argv[1], NULL, 0);
	}

	ret = flash_get_size(flash, &flash_size);
	if (ret < 0) {
		shell_error(sh, "Failed to get flash size (%d)", ret);
		return ret;
	}

	buf = k_malloc(FLASH_STRESS_TEST_SIZE);
	if (buf == NULL) {
		shell_error(sh, "Buffer allocation failed");
		return -ENOMEM;
	}

	ret = pm_device_action_run(flash, PM_DEVICE_ACTION_RESUME);
	if (ret < 0) {
		shell_error(sh, "Failed to resume flash (%d)", ret);
		goto err_free;
	}

	for (unsigned int i = 0; i < iters; i++) {
		uint32_t addr, lfsr_seed, lfsr_cur;

		addr = sys_rand32_get() % flash_size;

		ret = flash_get_page_info_by_offs(flash, addr, &info);
		if (ret < 0) {
			shell_error(sh, "Failed to get page info (%d)", ret);
			goto err_suspend;
		}

		shell_print(sh, "Stress test iteration %u: addr 0x%08x", i, (uint32_t)info.start_offset);

		ret = flash_erase(flash, info.start_offset, info.size);
		if (ret < 0) {
			shell_error(sh, "Failed to erase flash (%d)", ret);
			goto err_suspend;
		}

		lfsr_seed = sys_rand32_get();
		if (lfsr_seed == 0U) {
			lfsr_seed = 1U;
		}

		lfsr_cur = lfsr_seed;
		for (unsigned int i = 0U; i < FLASH_STRESS_TEST_SIZE; i++) {
			buf[i] = (uint8_t)lfsr_cur;
			lfsr_cur = xorshift32(lfsr_cur);
		}

		ret = flash_write(flash, info.start_offset, buf, FLASH_STRESS_TEST_SIZE);
		if (ret < 0) {
			shell_error(sh, "Failed to write to flash (%d)", ret);
			goto err_suspend;
		}

		memset(buf, 0, FLASH_STRESS_TEST_SIZE);
		ret = flash_read(flash, info.start_offset, buf, FLASH_STRESS_TEST_SIZE);
		if (ret < 0) {
			shell_error(sh, "Failed to read from flash (%d)", ret);
			goto err_suspend;
		}

		lfsr_cur = lfsr_seed;
		for (unsigned int i = 0U; i < FLASH_STRESS_TEST_SIZE; i++) {
			if (buf[i] != (uint8_t)lfsr_cur) {
				shell_error(
					sh,
					"Miscompare at offset %u: expected 0x%02x, found 0x%02x", 0,
					(uint8_t)lfsr_cur, buf[i]);
				ret = -EINVAL;
				goto err_suspend;
			}
			lfsr_cur = xorshift32(lfsr_cur);
		}
	}

	shell_print(sh, "Flash stress test done! All %u iterations passed", iters);

err_suspend:
	(void)pm_device_action_run(flash, PM_DEVICE_ACTION_SUSPEND);

err_free:
	k_free(buf);

	return ret;
}

SHELL_STATIC_SUBCMD_SET_CREATE(
	sub_flash_cmds, SHELL_CMD(id, NULL, "Read flash ID", cmd_flash_id),
	SHELL_CMD_ARG(erase, NULL, "Erase page: erase PAGE_ADDR", cmd_flash_erase, 2, 0),
	SHELL_CMD_ARG(read, NULL, "Read: read ADDR NUM_BYTES", cmd_flash_read, 3, 0),
	SHELL_CMD_ARG(write, NULL, "Write: write ADDR DATA", cmd_flash_write, 3, 0),
	SHELL_CMD_ARG(stress, NULL, "Stress: stress [ITERS]", cmd_flash_stress, 1, 1),
	SHELL_SUBCMD_SET_END);

SHELL_SUBCMD_ADD((hwv), flash, &sub_flash_cmds, "Flash", NULL, 0, 0);

static const int RDSR1 = 0x05;
static const int SECURITY_REGISTER_ID = 0x20;
static const int OTP_FIELD_SIZE = 32;
static const int SERIAL_FIELD = 0;
static const int HWVER_FIELD = 1;
static const int PCBASERIAL_FIELD = 2;

static int wait_for_flash_not_busy() {
  nrf_qspi_cinstr_conf_t instr = NRFX_QSPI_DEFAULT_CINSTR(RDSR1, 2);
  instr.io2_level = true;
  instr.io3_level = true;
  uint8_t sr1 = 0xff;
  int loops = 0;
  while (1) {
    nrfx_err_t err = nrfx_qspi_cinstr_xfer(&instr, NULL, &sr1);
	if (err != NRFX_SUCCESS) return -EIO;
	if (!(sr1 & 0x01)) break;
	if (++loops > 1000) {
		return -EIO;
	}
	k_usleep(50);
  }
  return 0;
}

static int read_otp_byte(int addr, uint8_t *value)
{
	nrf_qspi_cinstr_conf_t instr = NRFX_QSPI_DEFAULT_CINSTR(0x48, 7);
	instr.io2_level = true;
	instr.io3_level = true;
	uint8_t out[6] = {0x00, 0x00, SECURITY_REGISTER_ID, 0x00, 0xff, 0xff};
	out[2] |= (addr >> 8) & 0x03;
	out[3] = (addr & 0xff);
	uint8_t in[6] = {0};
	nrfx_err_t err = nrfx_qspi_cinstr_xfer(&instr, out, in);
	if (err != NRFX_SUCCESS) return -999;
	*value = in[5];
	return 0;
}

static int prog_otp_byte(int addr, uint8_t data)
{
	nrf_qspi_cinstr_conf_t instr = NRFX_QSPI_DEFAULT_CINSTR(0x42, 6);
	instr.io2_level = true;
	instr.io3_level = true;
	instr.wren = true;
	uint8_t tx_data[5] = {0x00, 0x00, SECURITY_REGISTER_ID, 0x00, 0xff};
  	tx_data[2] |= (addr >> 8) & 0x03;
  	tx_data[3] = (addr & 0xff);
  	tx_data[4] = data;
  	nrfx_err_t err = nrfx_qspi_cinstr_xfer(&instr, tx_data, NULL);
	if (err != NRFX_SUCCESS) return -EIO;
	return wait_for_flash_not_busy();
}

static int prog_otp_field(const struct shell *sh, int field_idx, uint8_t *data_string)
{
	int ret;

	if (!initialized) {
		shell_error(sh, "Flash module not initialized");
		return -EPERM;
	}

	if (field_idx < 0 || field_idx > 2) {
		return -EINVAL;
	}

	int len = strlen(data_string);
	if (len >= 31) {
		shell_error(sh, "Data string too long");
		return -EINVAL;
	}

	ret = pm_device_action_run(flash, PM_DEVICE_ACTION_RESUME);
	if (ret < 0) {
		shell_error(sh, "Failed to resume flash (%d)", ret);
		return ret;
	}

	for (int i = 0; i <= len; i++) {
		ret = prog_otp_byte(field_idx * OTP_FIELD_SIZE + i, data_string[i]);
		if (ret < 0) {
			shell_error(sh, "Error programming byte (%d)", ret);
			return ret;
		}
	}

	return prog_otp_byte(field_idx * OTP_FIELD_SIZE + OTP_FIELD_SIZE - 1, 0);
}

static int cmd_otp_write(const struct shell *sh, size_t argc, char **argv)
{
	int ret;

	if (argc < 3) {
		shell_error(sh, "Missing arguments");
		return -EINVAL;
	}

	int otp_field = 0;
	if (!strcmp("serial", argv[1])) {
		otp_field = SERIAL_FIELD;
	} else if (!strcmp("pcba", argv[1])) {
		otp_field = PCBASERIAL_FIELD;
	} else if (!strcmp("hwver", argv[1])) {
		otp_field = HWVER_FIELD;
	} else {
		shell_error(sh, "Invalid field (try serial, pcba, hwver)");
		return -EINVAL;
	}

	ret = prog_otp_field(sh, otp_field, argv[2]);
	if (ret < 0) {
		shell_error(sh, "Failed to program OTP value (%d)", ret);
		goto end;
	}

end:
	(void)pm_device_action_run(flash, PM_DEVICE_ACTION_SUSPEND);

	return ret;
}

static int cmd_otp_erase(const struct shell *sh, size_t argc, char **argv)
{
	int ret;

	if (!initialized) {
		shell_error(sh, "Flash module not initialized");
		return -EPERM;
	}

	ret = pm_device_action_run(flash, PM_DEVICE_ACTION_RESUME);
	if (ret < 0) {
		shell_error(sh, "Failed to resume flash (%d)", ret);
		return ret;
	}

	nrf_qspi_cinstr_conf_t instr = NRFX_QSPI_DEFAULT_CINSTR(0x44, 5);
	instr.io2_level = true;
	instr.io3_level = true;
	instr.wren = true;
	uint8_t out[4] = {0x00, 0x00, SECURITY_REGISTER_ID, 0x00};
	nrfx_err_t err = nrfx_qspi_cinstr_xfer(&instr, out, NULL);
	if (err != NRFX_SUCCESS) {
		return -EIO;	
	} 
	wait_for_flash_not_busy();

	(void)pm_device_action_run(flash, PM_DEVICE_ACTION_SUSPEND);

	return ret;
}

static int cmd_otp_read(const struct shell *sh, size_t argc, char **argv)
{
	int ret;
	uint8_t otp_fields[3][OTP_FIELD_SIZE];

	if (!initialized) {
		shell_error(sh, "Flash module not initialized");
		return -EPERM;
	}

	ret = pm_device_action_run(flash, PM_DEVICE_ACTION_RESUME);
	if (ret < 0) {
		shell_error(sh, "Failed to resume flash (%d)", ret);
		return ret;
	}

	for (int i = 0; i < OTP_FIELD_SIZE * 3; i++) {
		ret = read_otp_byte(i, &otp_fields[0][i]);
		if (ret < 0) {
			shell_error(sh, "Failed to read OTP byte %d (%d)", i, ret);
			return ret;
		}
	}

	if (otp_fields[0][OTP_FIELD_SIZE-1] == 0) {
		shell_print(sh, "serial: %s", otp_fields[SERIAL_FIELD]);
	} else {
		shell_print(sh, "serial blank");
	}
	
	if (otp_fields[1][OTP_FIELD_SIZE-1] == 0) {
		shell_print(sh, "pcba: %s", otp_fields[PCBASERIAL_FIELD]);
	} else {
		shell_print(sh, "pcba blank");
	}

	if (otp_fields[2][OTP_FIELD_SIZE-1] == 0) {
		shell_print(sh, "hwver: %s", otp_fields[HWVER_FIELD]);
	} else {
		shell_print(sh, "hwver blank");
	}

	(void)pm_device_action_run(flash, PM_DEVICE_ACTION_SUSPEND);
	return ret;
}

SHELL_STATIC_SUBCMD_SET_CREATE(
	sub_otp_cmds, SHELL_CMD(read, NULL, "Read OTP values", cmd_otp_read),
	SHELL_CMD_ARG(write, NULL, "Write OTP value: write serial|pcba|hwver VALUE", cmd_otp_write, 3, 0),
	SHELL_CMD(erase, NULL, "Erase security register", cmd_otp_erase),
	SHELL_SUBCMD_SET_END);

SHELL_SUBCMD_ADD((hwv), otp, &sub_otp_cmds, "OTP", NULL, 0, 0);

int flash_init(void)
{
	int ret;

	if (!device_is_ready(flash)) {
		return -ENODEV;
	}

	ret = pm_device_action_run(flash, PM_DEVICE_ACTION_SUSPEND);
	if (ret < 0) {
		return ret;
	}

	initialized = true;

	return 0;
}
```

## src/lfxo.c
```c
#include <stdlib.h>

#include <zephyr/device.h>
#include <zephyr/devicetree.h>
#include <zephyr/drivers/clock_control.h>
#include <zephyr/drivers/clock_control/nrf_clock_control.h>
#include <zephyr/drivers/counter.h>
#include <zephyr/kernel.h>
#include <zephyr/shell/shell.h>
#include <zephyr/sys/timeutil.h>

#define MEASURE_TIME_S 10

static const struct device *const sys_clock = DEVICE_DT_GET_ONE(nordic_nrf_clock);
static const struct device *const timer = DEVICE_DT_GET(DT_NODELABEL(timer2));
static bool initialized;

static int cmd_lfxo_test(const struct shell *sh, size_t argc, char **argv)
{
	int ret;
	uint32_t top;
	bool measured = false;
	struct timeutil_sync_config sync_config = { 0};
	struct timeutil_sync_state sync_state = { 0 };
	uint64_t counter_ref = 0U;

	ARG_UNUSED(argc);
	ARG_UNUSED(argv);

	if (!initialized) {
		shell_error(sh, "LFXO module not initialized");
		return -EPERM;
	}

	ret = clock_control_on(sys_clock, CLOCK_CONTROL_NRF_SUBSYS_HF);
	if (ret < 0) {
		shell_error(sh, "Failed to start HF clock: %d\n", ret);
		return ret;
	}

	sync_config.ref_Hz = counter_get_frequency(timer);
	if (sync_config.ref_Hz == 0) {
		shell_error(sh, "Timer has no fixed frequency");
		return -ENOTSUP;
	}

	top = counter_get_top_value(timer);
	if (top != UINT32_MAX) {
		shell_error(sh, "Timer wraps at %u not at 32 bits", top);
		return -ENOTSUP;
	}

	ret = counter_start(timer);
	if (ret < 0) {
		shell_error(sh, "Failed to start timer: %d\n", ret);
		return ret;
	}

	sync_config.local_Hz = CONFIG_SYS_CLOCK_TICKS_PER_SEC;
	sync_state.cfg = &sync_config;

	shell_print(sh, "Checking timer at %u Hz against ticks at %u Hz\n", sync_config.ref_Hz,
		    sync_config.local_Hz);

	while (!measured) {
		uint32_t ctr;
		float skew;
		struct timeutil_sync_instant inst;

		ret = counter_get_value(timer, &ctr);
		if (ret < 0) {
			shell_error(sh, "Failed to get timer value: %d\n", ret);
			return ret;
		}

		counter_ref += ctr - (uint32_t)counter_ref;
		inst.ref = counter_ref;
		inst.local = k_uptime_ticks();

		ret = timeutil_sync_state_update(&sync_state, &inst);
		if (ret < 0) {
			shell_error(sh, "Sync update error: %d\n", ret);
			return ret;
		}

		if (ret == 0) {
			k_sleep(K_SECONDS(MEASURE_TIME_S));
			continue;
		}

		skew = timeutil_sync_estimate_skew(&sync_state);
		shell_print(sh, "Skew %f ; err %d ppb", (double)skew,
			    timeutil_sync_skew_to_ppb(skew));
		measured = true;
	}

	ret = counter_stop(timer);
	if (ret < 0) {
		shell_error(sh, "Failed to stop timer: %d\n", ret);
		return ret;
	}

	ret = clock_control_off(sys_clock, CLOCK_CONTROL_NRF_SUBSYS_HF);
	if (ret < 0) {
		shell_error(sh, "Failed to stop HF clock: %d\n", ret);
		return ret;
	}

	return 0;
}

SHELL_STATIC_SUBCMD_SET_CREATE(sub_lfxo_cmds,
			       SHELL_CMD(test, NULL, "Test LFXO accuracy", cmd_lfxo_test),
			       SHELL_SUBCMD_SET_END);

SHELL_SUBCMD_ADD((hwv), lfxo, &sub_lfxo_cmds, "LFXO", NULL, 0, 0);

int lfxo_init(void)
{
	if (!device_is_ready(sys_clock) || !device_is_ready(timer)) {
		return -ENODEV;
	}

	initialized = true;

	return 0;
}
```

## src/lfxo.h
```c
#ifndef APP_SRC_LFXO_H_
#define APP_SRC_LFXO_H_

int lfxo_init(void);

#endif /* APP_SRC_LFXO_H_ */
```

## src/mag.c
```c
#include <zephyr/drivers/sensor.h>
#include <zephyr/pm/device.h>
#include <zephyr/shell/shell.h>

static const struct device *const mag = DEVICE_DT_GET(DT_ALIAS(mag0));
static bool initialized;

static int cmd_mag_get(const struct shell *sh, size_t argc, char **argv)
{
	int err;
	struct sensor_value val, val_x, val_y, val_z;

	ARG_UNUSED(argc);
	ARG_UNUSED(argv);

	if (!initialized) {
		shell_error(sh, "Magure sensor module not initialized");
		return -EPERM;
	}

	val.val1 = 75;
	val.val2 = 0;
	err = sensor_attr_set(mag, SENSOR_CHAN_MAGN_XYZ, SENSOR_ATTR_SAMPLING_FREQUENCY, &val);
	if (err < 0) {
		shell_error(sh, "Failed to set sampling frequency (%d)", err);
		return err;
	}

	err = sensor_sample_fetch(mag);
	if (err < 0) {
		shell_error(sh, "Failed to fetch sensor data (%d)", err);
		return 0;
	}

	err = sensor_channel_get(mag, SENSOR_CHAN_MAGN_X, &val_x);
	if (err < 0) {
		shell_error(sh, "Failed to get X magnetic field data (%d)", err);
		return 0;
	}

	err = sensor_channel_get(mag, SENSOR_CHAN_MAGN_Y, &val_y);
	if (err < 0) {
		shell_error(sh, "Failed to get Y magnetic field data (%d)", err);
		return 0;
	}

	err = sensor_channel_get(mag, SENSOR_CHAN_MAGN_Z, &val_z);
	if (err < 0) {
		shell_error(sh, "Failed to get Z magnetic field data (%d)", err);
		return 0;
	}

	shell_print(sh, "Magnetic field (gauss): %.6f, %.6f, %.6f", val_x.val1 + val_x.val2 / 100.0,
		    val_y.val1 + val_y.val2 / 100.0, val_z.val1 + val_z.val2 / 100.0);

	val.val1 = 0;
	val.val2 = 0;
	err = sensor_attr_set(mag, SENSOR_CHAN_MAGN_XYZ, SENSOR_ATTR_SAMPLING_FREQUENCY, &val);
	if (err < 0) {
		shell_error(sh, "Failed to set sampling frequency (%d)", err);
		return err;
	}

	return 0;
}

SHELL_STATIC_SUBCMD_SET_CREATE(sub_mag_cmds, SHELL_CMD(get, NULL, "Get sensor data", cmd_mag_get),
			       SHELL_SUBCMD_SET_END);

SHELL_SUBCMD_ADD((hwv), mag, &sub_mag_cmds, "Magnetic sensor", NULL, 0, 0);

int mag_init(void)
{
	if (!device_is_ready(mag)) {
		return -ENODEV;
	}

	initialized = true;

	return 0;
}
```

## src/mag.h
```c
#ifndef APP_SRC_MAG_H_
#define APP_SRC_MAG_H_

#define MMC5603NJ_I2C_ADDR 0b0110000

#define MMC5603NJ_ADDR_XOUT0     0x00
#define MMC5603NJ_ADDR_XOUT1     0x01
#define MMC5603NJ_ADDR_YOUT0     0x02
#define MMC5603NJ_ADDR_YOUT1     0x03
#define MMC5603NJ_ADDR_ZOUT0     0x04
#define MMC5603NJ_ADDR_ZOUT1     0x05
#define MMC5603NJ_ADDR_XOUT2     0x06
#define MMC5603NJ_ADDR_YOUT2     0x07
#define MMC5603NJ_ADDR_ZOUT2     0x08
#define MMC5603NJ_ADDR_TOUT      0x09
#define MMC5603NJ_ADDR_STATUS1   0x18
#define MMC5603NJ_ADDR_ODR       0x1A
#define MMC5603NJ_ADDR_INTCTRL0  0x1B
#define MMC5603NJ_ADDR_INTCTRL1  0x1C
#define MMC5603NJ_ADDR_INTCTRL2  0x1D
#define MMC5603NJ_ADDR_ST_X_TH   0x1E
#define MMC5603NJ_ADDR_ST_Y_TH   0x1F
#define MMC5603NJ_ADDR_ST_Z_TH   0x20
#define MMC5603NJ_ADDR_ST_X      0x27
#define MMC5603NJ_ADDR_ST_Y      0x28
#define MMC5603NJ_ADDR_ST_Z      0x29
#define MMC5603NJ_ADDR_PRODUCTID 0x39

int mag_init(void);

#endif /* APP_SRC_MAG_H_ */
```

## src/mic.c
```c
#include <stdio.h>
#include <stdlib.h>

#include <zephyr/audio/dmic.h>
#include <zephyr/device.h>
#include <zephyr/drivers/flash.h>
#include <zephyr/kernel.h>
#include <zephyr/pm/device.h>
#include <zephyr/shell/shell.h>
#include <zephyr/sys/util.h>

#define SAMPLE_RATE_HZ 16000
#define SAMPLE_BITS    16
#define TIMEOUT_MS     1000
#define CAPTURE_MS     200
#define BLOCK_SIZE     ((SAMPLE_BITS / BITS_PER_BYTE) * (SAMPLE_RATE_HZ * CAPTURE_MS) / 1000)
#define BLOCK_COUNT    4

static const struct device *const dmic = DEVICE_DT_GET(DT_ALIAS(dmic0));
static const struct device *const flash = DEVICE_DT_GET(DT_ALIAS(flash0));

K_MEM_SLAB_DEFINE_STATIC(mem_slab, BLOCK_SIZE, BLOCK_COUNT, 4);

static struct pcm_stream_cfg stream = {
	.pcm_rate = SAMPLE_RATE_HZ,
	.pcm_width = SAMPLE_BITS,
	.block_size = BLOCK_SIZE,
	.mem_slab = &mem_slab,
};

static struct dmic_cfg cfg = {
	.io =
		{
			.min_pdm_clk_freq = 1000000,
			.max_pdm_clk_freq = 3500000,
			.min_pdm_clk_dc = 40,
			.max_pdm_clk_dc = 60,
		},
	.streams = &stream,
	.channel =
		{
			.req_num_streams = 1,
			.req_num_chan = 1,
		},
};

static bool initialized;

static int cmd_mic_capture(const struct shell *sh, size_t argc, char **argv)
{
	int ret;
	unsigned int time;
	unsigned int captures;
	struct flash_pages_info info;
	uint32_t addr;
	uint32_t total_size;
	int16_t buf;

	if (!initialized) {
		shell_error(sh, "Microphone module not initialized");
		return -EPERM;
	}

	if (argc > 1) {
		time = strtoul(argv[1], NULL, 10);
	} else {
		time = 1U;
	}

	captures = time * (1000 / CAPTURE_MS);

	ret = pm_device_action_run(flash, PM_DEVICE_ACTION_RESUME);
	if (ret < 0) {
		shell_error(sh, "Failed to resume flash (%d)", ret);
		return ret;
	}

	ret = flash_get_page_info_by_offs(flash, 0, &info);
	if (ret < 0) {
		shell_error(sh, "Failed to get flash page info (%d)", ret);
		goto err;
	}

	total_size = DIV_ROUND_UP(BLOCK_SIZE * captures, info.size) * info.size;
	ret = flash_erase(flash, 0, total_size);
	if (ret < 0) {
		shell_error(sh, "Failed to erase flash (%d)", ret);
		goto err;
	}

	ret = dmic_configure(dmic, &cfg);
	if (ret < 0) {
		shell_error(sh, "Failed to configure DMIC(%d)", ret);
		goto err;
	}

	ret = dmic_trigger(dmic, DMIC_TRIGGER_START);
	if (ret < 0) {
		shell_error(sh, "START trigger failed (%d)", ret);
		goto err;
	}

	addr = 0UL;
	for (unsigned int i = 0U; i < captures; i++) {
		void *buffer;
		uint32_t size;

		ret = dmic_read(dmic, 0, &buffer, &size, TIMEOUT_MS);
		if (ret < 0) {
			(void)dmic_trigger(dmic, DMIC_TRIGGER_STOP);
			shell_error(sh, "DMIC read failed (%d)", ret);
			goto err;
		}

		ret = flash_write(flash, addr, buffer, size);
		if (ret < 0) {
			(void)dmic_trigger(dmic, DMIC_TRIGGER_STOP);
			shell_error(sh, "Failed to write to flash (%d)", ret);
			goto err;
		}

		addr += size;
		k_mem_slab_free(&mem_slab, buffer);
	}

	ret = dmic_trigger(dmic, DMIC_TRIGGER_STOP);
	if (ret < 0) {
		shell_error(sh, "STOP trigger failed (%d)", ret);
		goto err;
	}

	shell_print(sh, "S");
	for (uint32_t i = 0U; i < addr / 2U; i++) {
		ret = flash_read(flash, i * 2U, &buf, 2U);
		if (ret < 0) {
			shell_error(sh, "Failed to read from flash (%d)", ret);
			goto err;
		}

		shell_print(sh, "%d", buf);
	}
	shell_print(sh, "E");

	ret = flash_erase(flash, 0, total_size);
	if (ret < 0) {
		shell_error(sh, "Failed to erase flash (%d)", ret);
		goto err;
	}

err:
	(void)pm_device_action_run(flash, PM_DEVICE_ACTION_SUSPEND);
	return ret;
}

SHELL_STATIC_SUBCMD_SET_CREATE(sub_mic_cmds,
			       SHELL_CMD_ARG(capture, NULL, "Capture microphone data", cmd_mic_capture, 1, 1),
			       SHELL_SUBCMD_SET_END);

SHELL_SUBCMD_ADD((hwv), mic, &sub_mic_cmds, "Microphone", NULL, 0, 0);

int mic_init(void)
{
	if (!device_is_ready(dmic)) {
		return -ENODEV;
	}

	cfg.channel.req_chan_map_lo = dmic_build_channel_map(0, 0, PDM_CHAN_LEFT);

	initialized = true;

	return 0;
}
```

## src/speaker.c
```c
#include "audio_data.h"

#include <zephyr/sys/__assert.h>
#include <zephyr/drivers/i2c.h>
#include <zephyr/kernel.h>
#include <zephyr/shell/shell.h>
#include <zephyr/irq.h>


#include "hal/nrf_clock.h"
#include "hal/nrf_gpio.h"
#include "nrfx_i2s.h"

#define DA7212_PLL_STATUS            0x03
#define DA7212_CIF_CTRL              0x1D
#define DA7212_DIG_ROUTING_DAI       0x21
#define DA7212_SR                    0x22
#define DA7212_REFERENCES            0x23
#define DA7212_PLL_FRAC_TOP          0x24
#define DA7212_PLL_FRAC_BOT          0x25
#define DA7212_PLL_INTEGER           0x26
#define DA7212_PLL_CTRL              0x27
#define DA7212_DAI_CLK_MODE          0x28
#define DA7212_DAI_CTRL              0x29
#define DA7212_DIG_ROUTING_DAC       0x2A
#define DA7212_DAC_FILTERS5          0x40
#define DA7212_DAC_R_GAIN            0x46
#define DA7212_LINE_GAIN             0x4A
#define DA7212_MIXOUT_R_SELECT       0x4C
#define DA7212_SYSTEM_MODES_OUTPUT   0x51
#define DA7212_DAC_R_CTRL            0x6A
#define DA7212_LINE_CTRL             0x6D
#define DA7212_MIXOUT_R_CTRL         0x6F
#define DA7212_LDO_CTRL              0x90
#define DA7212_GAIN_RAMP_CTRL        0x92
#define DA7212_TONE_GEN_CFG1         0xB4
#define DA7212_TONE_GEN_CYCLES       0xB6
#define DA7212_TONE_GEN_ON_PER       0xBB
#define DA7212_SYSTEM_ACTIVE         0xFD

static bool initialized;

static nrfx_i2s_buffers_t s_i2s_bufs;
static const nrfx_i2s_t s_i2s = NRFX_I2S_INSTANCE(0);
static nrfx_i2s_config_t s_i2s_cfg = NRFX_I2S_DEFAULT_CONFIG(
	 NRF_GPIO_PIN_MAP(0, 12), NRF_GPIO_PIN_MAP(0, 7), NRF_GPIO_PIN_MAP(1, 9),
	NRF_GPIO_PIN_MAP(0, 13), NRF_I2S_PIN_NOT_CONNECTED);

static const struct i2c_dt_spec codec = I2C_DT_SPEC_GET(DT_NODELABEL(da7212));

#define SINE_WAVE_TOTAL_SAMPLES 32

/* Stereo sine wave data (L, R, L, R, ...) */
int16_t sine_wave[SINE_WAVE_TOTAL_SAMPLES] = {
	0,     0,     3134,  3134,  5791,  5791,  7567,  7567,  8191,  8191,  7567,
	7567,  5791,  5791,  3134,  3134,  0,     0,     -3134, -3134, -5791, -5791,
	-7567, -7567, -8191, -8191, -7567, -7567, -5791, -5791, -3134, -3134};

static void da7212_register_write(uint8_t reg, uint8_t value) {
  int ret;

  ret = i2c_reg_write_byte_dt(&codec, reg, value);
  __ASSERT(ret == 0, "Failed to write to DA7212 register 0x%02x", reg);
}

static uint8_t da7212_register_read(uint8_t reg) {
  uint8_t data;
  int ret;

  ret = i2c_reg_read_byte_dt(&codec, reg, &data);
  __ASSERT(ret == 0, "Failed to read from DA7212 register 0x%02x", reg);

  return data;
}

static void prv_codec_setup(void) {
  // CIF_CTRL: soft reset
  da7212_register_write(DA7212_CIF_CTRL, 0x80);

  k_msleep(10);

  // SYSTEM_ACTIVE: wake-up
  da7212_register_write(DA7212_SYSTEM_ACTIVE, 0x01);

  // REFERENCES: enable master bias
  da7212_register_write(DA7212_REFERENCES, 0x08);

  //k_msleep(30);

  // LDO_CTRL: enable LDO, 1.05V
  da7212_register_write(DA7212_LDO_CTRL, 0x80);

  // PLL: MCLK=4MHz (so input divider=2), we need 12.288MHz System Clock for SR=16KHz (see table 34)
  // VCO = System Clock * 8 = 98.304MHz
  // Feedback divider = VCO * Input Divider / MCLK
  //                  = 98.304MHz * 2 / 4MHz = 49.152
  // PLL_INTEGER = 49 (0x31)
  // PLL_FRAC = 0.152 * 2^13 = 1245 (0x4dd)
  // PLL_FRAC_TOP = 0x04
  // PLL_FRAC_BOT = 0xdd
  da7212_register_write(DA7212_PLL_FRAC_TOP, 0x04);
  da7212_register_write(DA7212_PLL_FRAC_BOT, 0xdd);
  da7212_register_write(DA7212_PLL_INTEGER, 0x31);

  // PLL_CTRL: enable + SRM, input clock range 2-10MHz
  da7212_register_write(DA7212_PLL_CTRL, 0xC0);

  // PLL: operate with a 2-5MHz MCLK (ref. DA7212 rev 3.6, 13.29)
  da7212_register_write(0xF0, 0x8B);
  da7212_register_write(0xF2, 0x03);
  da7212_register_write(0xF0, 0x00);

  k_msleep(40);

  __ASSERT(da7212_register_read(DA7212_PLL_STATUS) == 0x07, "DA7212 PLL not locked");

  // GAIN_RAMP_CTRL: 1s
  da7212_register_write(DA7212_GAIN_RAMP_CTRL, 0x02);
  // SR: 16KHz
  da7212_register_write(DA7212_SR, 0x05);
  // DAI_CLK_MODE: slave
  da7212_register_write(DA7212_DAI_CLK_MODE, 0x00);
  // DAI_CTRL: enable, 16-bit
  da7212_register_write(DA7212_DAI_CTRL, 0x80);
  // DIG_ROUTING_DAI: DAI_R/L_SRC to DAI_R/L
  da7212_register_write(DA7212_DIG_ROUTING_DAI, 0x32);
  // DIG_ROUTING_DAC: DAC_R/L mono mix of R/L
  da7212_register_write(DA7212_DIG_ROUTING_DAC, 0xba);
  // DAC_R_GAIN: 3dB
  da7212_register_write(DA7212_DAC_R_GAIN, 0x73);
  // DAC_R_CTRL: enable
  da7212_register_write(DA7212_DAC_R_CTRL, 0x80);
  // MIXOUT_R_SELECT: DAC_R
  da7212_register_write(DA7212_MIXOUT_R_SELECT, 0x08);
  // MIXOUT_R_CTRL: enable, softmix enable, amp enable
  da7212_register_write(DA7212_MIXOUT_R_CTRL, 0x98);
  // LINE_GAIN: 15dB
  da7212_register_write(DA7212_LINE_GAIN, 0x3f);
  // LINE_CTRL: enable
  da7212_register_write(DA7212_LINE_CTRL, 0x80);
}

static void prv_codec_standby(void) {
  da7212_register_write(DA7212_SYSTEM_ACTIVE, 0x00);
}

static void prv_data_handler(nrfx_i2s_buffers_t const *p_released, uint32_t status)
{
}

static void prv_playback(void)
{
	nrfx_err_t err;

	// MCLK: 4MHz, sample rate: ~16KHz (4Mhz / 256 = 15625Hz)
	s_i2s_cfg.mck_setup = NRF_I2S_MCK_32MDIV8;
	s_i2s_cfg.ratio = NRF_I2S_RATIO_256X;
	s_i2s_cfg.channels = NRF_I2S_CHANNELS_STEREO;

	err = nrfx_i2s_init(&s_i2s, &s_i2s_cfg, prv_data_handler);
	__ASSERT_NO_MSG(err == NRFX_SUCCESS);

	s_i2s_bufs.p_tx_buffer = (uint32_t *)sine_wave;
	s_i2s_bufs.buffer_size = SINE_WAVE_TOTAL_SAMPLES / 2;
	err = nrfx_i2s_start(&s_i2s, &s_i2s_bufs, 0);
	__ASSERT_NO_MSG(err == NRFX_SUCCESS);

	prv_codec_setup();

	k_msleep(3000);

	prv_codec_standby();

	nrfx_i2s_stop(&s_i2s);
	nrfx_i2s_uninit(&s_i2s);
}

static void i2s_isr_shim(const void *ctx)
{
	nrfx_i2s_0_irq_handler();
}

static int cmd_speaker_play(const struct shell *sh, size_t argc, char **argv)
{
	int ret;

	ARG_UNUSED(argc);
	ARG_UNUSED(argv);

	if (!initialized) {
		shell_error(sh, "Speaker module not initialized");
		return -EPERM;
	}

	nrf_clock_event_clear(NRF_CLOCK, NRF_CLOCK_EVENT_HFCLKSTARTED);
	nrf_clock_task_trigger(NRF_CLOCK, NRF_CLOCK_TASK_HFCLKSTART);
	while (!nrf_clock_event_check(NRF_CLOCK, NRF_CLOCK_EVENT_HFCLKSTARTED)) {
	}
	nrf_clock_event_clear(NRF_CLOCK, NRF_CLOCK_EVENT_HFCLKSTARTED);

	prv_playback();

	shell_print(sh, "Speaker test done");

	return 0;
}

SHELL_STATIC_SUBCMD_SET_CREATE(sub_speaker_cmds,
			       SHELL_CMD(play, NULL, "Play sound", cmd_speaker_play),
			       SHELL_SUBCMD_SET_END);

SHELL_SUBCMD_ADD((hwv), speaker, &sub_speaker_cmds, "Speaker", NULL, 0, 0);

int speaker_init(void)
{
	if (!i2c_is_ready_dt(&codec)) {
		return -ENODEV;
	}

	IRQ_CONNECT(I2S_IRQn, 0, i2s_isr_shim, NULL, 0);
	irq_enable(I2S_IRQn);

	initialized = true;

	return 0;
}
```
